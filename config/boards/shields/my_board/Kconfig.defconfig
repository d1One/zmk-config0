## config/boards/shields/my_board/Kconfig.defconfig
```kconfig
# Copyright (c) 2020 The ZMK Contributors
# SPDX-License-Identifier: MIT

if SHIELD_MY_BOARD

config ZMK_KEYBOARD_NAME
    default "My Board"

endif
```
